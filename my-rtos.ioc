# file: my-rtos.ioc
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Mcu.Family=STM32L4
Mcu.Name=STM32L432K(B-C)Ux
Mcu.Package=UFQFPN32
NVIC.PriorityGroup=NVIC_PRIORITYGROUP_4
PA0.GPIO_Label=MCO [High speed clock in]
PA0.Signal=RCC_CK_IN
PA13\ (JTMS-SWDIO).GPIO_Label=SWDIO
PA13\ (JTMS-SWDIO).Signal=SYS_JTMS-SWDIO
PA14\ (JTCK-SWCLK).GPIO_Label=SWCLK
PA14\ (JTCK-SWCLK).Signal=SYS_JTCK-SWCLK
PA15\ (JTDI).GPIO_Label=VCP_RX
PA15\ (JTDI).Signal=USART2_RX
PA2.GPIO_Label=VCP_TX
PA2.Signal=USART2_TX
PB3\ (JTDO-TRACESWO).GPIO_Label=LD3 [Green]
PB3\ (JTDO-TRACESWO).Signal=GPIO_Output
PC14-OSC32_IN\ (PC14).Signal=RCC_OSC32_IN
PC15-OSC32_OUT\ (PC15).Signal=RCC_OSC32_OUT
ProjectManager.HeapSize=0x200
ProjectManager.StackSize=0x400
ProjectManager.TargetToolchain=Makefile
RCC.AHBFreq_Value=32000000
RCC.APB1Freq_Value=32000000
RCC.APB1TimFreq_Value=32000000
RCC.APB2Freq_Value=32000000
RCC.APB2TimFreq_Value=32000000
RCC.CortexFreq_Value=32000000
RCC.HCLKFreq_Value=32000000
RCC.HSE_VALUE=8000000
RCC.HSI16_VALUE=16000000
RCC.HSI48_VALUE=48000000
RCC.HSI_VALUE=16000000
RCC.LSE_VALUE=32768
RCC.MSI_VALUE=4000000
RCC.PLLMUL=RCC_PLLMUL_4
RCC.PLLN=16
RCC.SYSCLKFreq_VALUE=32000000
RCC.SYSCLKSource=RCC_SYSCLKSOURCE_PLLCLK
RCC.VCOOutputFreq_Value=64000000
board=NUCLEO-L432KC

// file: Core/Src/main.c
/* USER CODE BEGIN Header */
/**
  ******************************************************************************
  * @file           : main.c
  * @brief          : Main program body
  ******************************************************************************
  * @attention
  *
  * Copyright (c) 2025 STMicroelectronics.
  * All rights reserved.
  *
  * This software is licensed under terms that can be found in the LICENSE file
  * in the root directory of this software component.
  * If no LICENSE file comes with this software, it is provided AS-IS.
  *
  ******************************************************************************
  */
/* USER CODE END Header */
#include "main.h"

void SystemClock_Config(void);

void SystemClock_Config(void)
{
  // LL_FLASH_SetLatency(LL_FLASH_LATENCY_1);
  // while(LL_FLASH_GetLatency()!= LL_FLASH_LATENCY_1)
  // {
  // }
  // LL_PWR_SetRegulVoltageScaling(LL_PWR_REGU_VOLTAGE_SCALE1);
  // while (LL_PWR_IsActiveFlag_VOS() != 0)
  // {
  // }
  // LL_RCC_MSI_Enable();

  //  /* Wait till MSI is ready */
  // while(LL_RCC_MSI_IsReady() != 1)
  // {

  // }
  // LL_RCC_MSI_EnableRangeSelection();
  // LL_RCC_MSI_SetRange(LL_RCC_MSIRANGE_6);
  // LL_RCC_MSI_SetCalibTrimming(0);
  // LL_RCC_PLL_ConfigDomain_SYS(LL_RCC_PLLSOURCE_MSI, LL_RCC_PLLM_DIV_1, 16, LL_RCC_PLLR_DIV_2);
  // LL_RCC_PLL_EnableDomain_SYS();
  // LL_RCC_PLL_Enable();

  //  /* Wait till PLL is ready */
  // while(LL_RCC_PLL_IsReady() != 1)
  // {

  // }
  // LL_RCC_SetSysClkSource(LL_RCC_SYS_CLKSOURCE_PLL);

  //  /* Wait till System clock is ready */
  // while(LL_RCC_GetSysClkSource() != LL_RCC_SYS_CLKSOURCE_STATUS_PLL)
  // {

  // }
  // LL_RCC_SetAHBPrescaler(LL_RCC_SYSCLK_DIV_1);
  // LL_RCC_SetAPB1Prescaler(LL_RCC_APB1_DIV_1);
  // LL_RCC_SetAPB2Prescaler(LL_RCC_APB2_DIV_1);

  // LL_Init1msTick(32000000);

  // LL_SetSystemCoreClock(32000000);
}

void Error_Handler(void)
{
  /* USER CODE BEGIN Error_Handler_Debug */
  /* User can add his own implementation to report the HAL error return state */
  // __disable_irq();
  while (1)
  {
  }
  /* USER CODE END Error_Handler_Debug */
}

int main() {
  return 0;
}
